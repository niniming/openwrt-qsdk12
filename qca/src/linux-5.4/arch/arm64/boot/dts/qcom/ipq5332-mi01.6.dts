// SPDX-License-Identifier: (GPL-2.0+ OR BSD-3-Clause)
/*
 * IPQ5332 MI01.6 board device tree source
 *
 * Copyright (c) 2020-2021 The Linux Foundation. All rights reserved.
 * Copyright (c) 2022 Qualcomm Innovation Center, Inc. All rights reserved.
 */

/dts-v1/;

#include "ipq5332-mi01.4.dts"

/ {
	model = "Qualcomm Technologies, Inc. IPQ5332/AP-MI01.6";
	compatible = "qcom,ipq5332-ap-mi01.6", "qcom,ipq5332";
};
