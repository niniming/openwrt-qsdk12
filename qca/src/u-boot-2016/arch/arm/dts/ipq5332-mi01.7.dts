/*
 * Copyright (c) 2016-2019, The Linux Foundation. All rights reserved.
 *
 * Copyright (c) 2022 Qualcomm Innovation Center, Inc. All rights reserved.
 *
 * This program is free software; you can redistribute it and/or modify
 * it under the terms of the GNU General Public License version 2 and
 * only version 2 as published by the Free Software Foundation.
 *
 * This program is distributed in the hope that it will be useful,
 * but WITHOUT ANY WARRANTY; without even the implied warranty of
 * MERCHANTABILITY or FITNESS FOR A PARTICULAR PURPOSE.  See the
 * GNU General Public License for more details.
 */

/dts-v1/;
#include "ipq5332-mi01.1.dts"
/ {
	machid = <0x8060007>;
	config_name = "config@mi01.7";

	ess-switch {
		switch_mac_mode0 = <PORT_WRAPPER_SGMII_PLUS>;
		switch_mac_mode1 = <PORT_WRAPPER_10GBASE_R>;
		qca808x_gpio = <16>;
		qca808x_gpio_cnt = <1>;
		mdc_mdio_gpio = <27 28>;
		qca8084_switch_enable = <1>;
		/delete-property/napa_gpio;

		port_phyinfo {
			port@1 {
				/delete-property/phy_address;
				phy_type = <SFP_PHY_TYPE>;
				uniphy_id = <1>;
				uniphy_mode = <PORT_WRAPPER_10GBASE_R>;
			};
		};
	};
};
